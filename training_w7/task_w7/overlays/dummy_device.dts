/dts-v1/;
/plugin/;

/ {
	compatible = "brcm,bcm2711";

	fragment@0 {
		target-path = "/";

		__overlay__ {
			/* ==========================================================
			 * 1. THIẾT BỊ GIẢ LẬP 1: BỘ TẠO XUNG NHỊP ẢO (FIXED CLOCK)
			 * Mô phỏng một thạch anh 50MHz cấp dao động cho hệ thống
			 * ==========================================================
			 */
			dummy_clock: dummy_clk_50mhz {
				compatible = "fixed-clock";
				#clock-cells = <0>;
				clock-frequency = <50000000>;      /* Tần số 50 MHz */
				clock-output-names = "sim_clk_50m"; /* Tên xung nhịp */
			};

			/* ==========================================================
			 * 2. THIẾT BỊ GIẢ LẬP 2: BỘ CẤP NGUỒN ẢO (FIXED REGULATOR)
			 * Mô phỏng IC cấp nguồn điện áp cố định 3.3V (3,300,000 uV)
			 * ==========================================================
			 */
			dummy_regulator: dummy_vreg_3v3 {
				compatible = "regulator-fixed";
				regulator-name = "dummy_3v3_power"; /* Tên nguồn */
				regulator-min-microvolt = <3300000>; /* 3.3V */
				regulator-max-microvolt = <3300000>; /* 3.3V */
				regulator-always-on;                /* Luôn bật */
			};
		};
	};
};
